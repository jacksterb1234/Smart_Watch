## Software/boards/arm/custom_smartwatch/Kconfig
```kconfig
# SPDX-License-Identifier: Apache-2.0

config BOARD_CUSTOM_SMARTWATCH
	select SOC_NRF5340_CPUAPP_QKAA if BOARD_CUSTOM_SMARTWATCH_NRF5340_CPUAPP
	select SOC_NRF5340_CPUNET_QKAA if BOARD_CUSTOM_SMARTWATCH_NRF5340_CPUNET
```

## Software/boards/arm/custom_smartwatch/board.yml
```yaml
board:
  name: custom_smartwatch
  full_name: Custom Smartwatch
  vendor: custom
  socs:
    - name: nrf5340
      variants:
        - name: ns
          cpucluster: cpuapp
```
